## boot/zephyr/boards/arm/bt832f_fob/Kconfig.board
```kconfig
# Copyright (c) 2024 Nordic Semiconductor ASA
# SPDX-License-Identifier: Apache-2.0

config BOARD_BT832F_FOB
	bool "bt832f_fob"
	depends on SOC_NRF52832_QFAA
```

## boot/zephyr/boards/arm/bt832f_fob/Kconfig.defconfig
```kconfig
# Copyright (c) 2024 Nordic Semiconductor ASA
# SPDX-License-Identifier: Apache-2.0

if BOARD_BT832F_FOB

config BOARD
	default "bt832f_fob"

config BT_CTLR
   default BT


endif
```
